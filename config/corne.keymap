/*
 * Copyright (c) 2020 The ZMK Contributors
 *
 * SPDX-License-Identifier: MIT
 */


#include "../lib/base.dtsi"

#include "../lib/behaviors.dtsi"
#include "../lib/combos.dtsi"
#include "../lib/corne_keymap.dtsi"
